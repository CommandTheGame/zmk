keymap {
    compatible = "zmk,keymap";

    layer_state {
        bindings = <&default_layer>;
    };

    default_layer {
        bindings = <
            &kp Q    &kp W    &kp E    &kp R    &kp T    &kp Z    &kp U    &kp I    &kp O    &kp P
            &kp A    &kp S    &kp D    &kp F    &kp G    &kp H    &kp J    &kp K    &kp L    &kp OE
            &kp Y    &kp X    &kp C    &kp V    &kp B    &kp N    &kp M    &kp COMMA &kp DOT  &kp MINUS
            &mo 1    &kp LCTRL &kp LALT  &kp LGUI &kp SPACE  &kp LSFT
        >;
    };

    function_layer {
        bindings = <
            &kp F1   &kp F2   &kp F3   &kp F4   &kp F5   &kp F6   &kp F7   &kp F8   &kp F9   &kp F10
            &kp VOL_UP  &kp C_PREV  &kp C_PLAY  &kp C_NEXT  &kp MUTE  &kp LEFT  &kp DOWN  &kp UP  &kp RIGHT  &kp ENTER
            &kp AE    &kp UE    &kp SS    &kp EURO    &kp DQT    &kp SQT    &kp LPAR    &kp RPAR    &kp QMARK    &kp EXCL
            &rgb_underglow_hue_up &rgb_underglow_hue_down &rgb_underglow_brightness_up &rgb_underglow_brightness_down &rgb_underglow_mode_next
            &mo 1    &kp LCTRL &kp LALT  &kp LGUI &kp SPACE  &kp LSFT
        >;
    };
};
