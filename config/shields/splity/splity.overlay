/ {
    chosen {
        zmk,keyboard = &my_keyboard_kbd;
    };
};

&my_keyboard_kbd {
    compatible = "zmk,keyboard";

    matrix-row-gpios = <&gpio0 10 0>, <&gpio1 11 0>, <&gpio1 13 0>, <&gpio1 15 0>, <&gpio0 02 0>;

    matrix-column-gpios = <&gpio1 1 0>, <&gpio1 2 0>, <&gpio1 7 0>, <&gpio1 4 0>, <&gpio1 6 0>, <&gpio0 9 0>;
};
