## app/boards/shields/splity/Kconfig
```kconfig
config SHIELD_SPLITY
    bool "Splity"
    depends on BOARD_NICE_NANO_V2
    default y
```

## config/west.yml
```yaml
manifest:
  projects:
    - name: zmk
      url: https://github.com/zmkfirmware/zmk.git
      revision: main
      west-commands: scripts/west-commands.yml
      import: app/west.yml  # Loads the main ZMK config
  self:
    path: config
```
